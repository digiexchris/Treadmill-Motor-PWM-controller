## boards/weact/blackpill_f411ce_RPM/Kconfig.blackpill_f411ce_RPM
```kconfig
# Copyright (c) 2020 Brian Bradley
# SPDX-License-Identifier: Apache-2.0

config BOARD_BLACKPILL_F411CE_RPM
	select SOC_STM32F411XE
```

## boards/weact/blackpill_f411ce_RPM/board.yml
```yaml
board:
  name: blackpill_f411ce_RPM
  vendor: weact
  socs:
    - name: stm32f411xe
```
